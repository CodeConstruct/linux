## drivers/obmf-icp/Kconfig
```kconfig
config OBMF_ICP
	tristate "Open Boot and Management Framework - Interface Consolidation Protocol"
	help
	  Enable support for USB devices implementing OBMF-ICP

if OBMF_ICP

menu "OBMF ICP transport drivers"

config OBMF_ICP_TRANSPORT_USB
	tristate "OBMF-ICP USB transport"
	depends on USB
	help
	  USB transport driver for OBMF-ICP devices.

	  This driver implements a USB class driver for OBMF-ICP devices,
	  allowing I/O expansion over the host side of a USB connection,
	  typically used for server platform management.

	  If unsure, say 'n'

endmenu

menu "OMBF ICP channel drivers"

config OBMF_ICP_GPIO
	tristate "GPIO channel driver"
	depends on GPIOLIB
	select GPIOLIB_IRQCHIP
	help
	  Driver for OBMF-ICP General-Purpose IO (GPIO) channels.

	  This driver implements a standard Linux gpiochip over an OBMF-ICP
	  gpio-type channel.

	  If unsure, say 'n'
endmenu

endif
```
